.EQU DPRT = PORTA
.EQU DDDR = DDRA
.EQU CPRT = PORTB
.EQU CDDR = DDRB
.EQU RS = 0
.EQU RW = 1
.EQU E = 2

LDI R16, 0xFF
OUT DDDR, R16
OUT CDDR, R16

CBI CPRT, E
CALL DELAY_2ms

LDI R16, 0x38
CALL CMNDWRT
CALL DELAY_2ms

LDI R16, 0x0E
CALL CMNDWRT

LDI R16, 0x01
CALL CMNDWRT
CALL DELAY_2ms

LDI R16, 0x06
CALL CMNDWRT

LDI R16, 'H'
CALL DATAWRT

LDI R16, 'i'
CALL DATAWRT

HERE:
RJMP HERE

CMNDWRT:
OUT DPRT, R16
CBI CPRT, RS
CBI CPRT, RW
SBI CPRT, E
CALL SDELAY
CBI CPRT, E
CALL DELAY_100us
RET

DATAWRT:
OUT DPRT, R16
SBI CPRT, RS
CBI CPRT, RW
SBI CPRT, E
CALL SDELAY
CBI CPRT, E
CALL DELAY_100us
RET

SDELAY:
NOP
NOP
RET

DELAY_100us:
PUSH R17
LDI R17, 60
DR0:
CALL SDELAY
DEC R17
BRNE DR0
POP R17
RET

DELAY_2ms:
PUSH R17
LDI R17, 20
LDR0:
CALL DELAY_100us
DEC R17
BRNE LDR0
POP R17
RET